## meta-creaturepod/conf/layer.conf
```bitbake
# We have a conf and classes directory, add to BBPATH
BBPATH .= ":${LAYERDIR}"

# We have recipes-* directories, add to BBFILES
BBFILES += "${LAYERDIR}/recipes-*/*/*.bb \
            ${LAYERDIR}/recipes-*/*/*.bbappend"

BBFILE_COLLECTIONS += "meta-creaturepod"
BBFILE_PATTERN_meta-creaturepod = "^${LAYERDIR}/"
BBFILE_PRIORITY_meta-creaturepod = "6"

LAYERDEPENDS_meta-creaturepod = "core"
LAYERSERIES_COMPAT_meta-creaturepod = "scarthgap"
```
